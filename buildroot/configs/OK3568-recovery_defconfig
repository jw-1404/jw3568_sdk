## buildroot/configs/OK3568-recovery_defconfig
```kconfig
#include "base.config"
#include "base_extra.config"
#include "recovery.config"
#include "rk356x_arm64.config"
BR2_ROOTFS_OVERLAY="board/rockchip/ok3568/fs-overlay-recovery/"
BR2_TARGET_GENERIC_GETTY_BAUDRATE_115200=y
```

## buildroot/configs/jw3568-v2_defconfig
```kconfig
### SoC ###

#include "rk356x_arm64.config"
#include "kernel.config"

### jinawei-specific ###

# image-info customization
BR2_TARGET_GENERIC_ISSUE="Welcome to JW3568 DPU-Lite"
BR2_TARGET_GENERIC_HOSTNAME="jw3568"
BR2_TARGET_GENERIC_ROOT_PASSWD="admin"
BR2_TARGET_LOCALTIME="Asia/Shanghai"
BR2_ROOTFS_OVERLAY="board/rockchip/jw3568/fs-overlay/"
BR2_TARGET_GENERIC_GETTY_BAUDRATE_115200=y

# system
#include "jianwei_base.config"

# packages
#include "jianwei_nogui.config"
```

## buildroot/configs/jw3568_defconfig
```kconfig
#include "rk356x_arm64.config"
#include "base.config"
#include "base_extra.config"
#include "benchmark.config"
#include "test.config"
#include "debug.config"
#include "debug2.config"
#include "ntfs.config"
#include "qt.config"
#include "ros2_dep.config"
#include "camera.config"
#include "camera_gst.config"
#include "video_mpp.config"
#include "video_gst.config"
#include "video_gst_rtsp.config"
BR2_TARGET_GENERIC_ROOT_PASSWD="jw3568"
BR2_TARGET_GENERIC_GETTY_BAUDRATE_115200=y
BR2_TARGET_LOCALTIME="Asia/Shanghai"
BR2_ROOTFS_OVERLAY="board/rockchip/jw3568/fs-overlay/"
BR2_PACKAGE_TENSORFLOW=y
BR2_PACKAGE_RKNPU2=y
BR2_PACKAGE_RKAIQ_TOOL_SERVER=y
BR2_PACKAGE_FORLINX=y
BR2_PACKAGE_FORLINX_CMD=y
BR2_PACKAGE_FFMPEG_AVRESAMPLE=y
BR2_PACKAGE_FFMPEG_SWSCALE=y
BR2_PACKAGE_HICOLOR_ICON_THEME=y
BR2_PACKAGE_QT5BASE_SQLITE_QT=y
BR2_PACKAGE_QT5BASE_GIF=y
BR2_PACKAGE_QT5CHARTS=y
BR2_PACKAGE_QT5SERIALBUS=y
BR2_PACKAGE_QT5WEBKIT=y
BR2_PACKAGE_QT5WEBENGINE=y
BR2_PACKAGE_UBOOT_TOOLS=y
BR2_PACKAGE_LZO=y
BR2_PACKAGE_IPROUTE2=y
BR2_PACKAGE_IPTABLES=y
BR2_PACKAGE_IPTABLES_BPF_NFSYNPROXY=y
BR2_PACKAGE_IPTABLES_NFTABLES=y
BR2_PACKAGE_LIGHTTPD=y
BR2_PACKAGE_LIGHTTPD_PCRE=y
BR2_PACKAGE_OPENSSH=y
BR2_PACKAGE_VSFTPD=y
BR2_PACKAGE_RKWIFIBT=n
BR2_PACKAGE_USBMOUNT=n
BR2_PACKAGE_QT5SERIALPORT=y
BR2_PACKAGE_HOST_GDB=y
BR2_PACKAGE_HOST_GDB_TUI=y
BR2_PACKAGE_HOST_GDB_PYTHON=y
BR2_PACKAGE_HOST_GDB_SIM=y
BR2_GDB_VERSION_8_1=y
BR2_PACKAGE_GDB_NEEDS_CXX11=y
BR2_GDB_VERSION="8.1.1"

# jianwei-specific
#include "jianwei.config"
```

## buildroot/package/cc-tutorial/Config.in
```kconfig
config BR2_PACKAGE_CC_TUTORIAL
	bool "cc-tutorial"
	select BR2_PACKAGE_CC_COMMS
  depends on BR2_PACKAGE_HOST_CC_COMMSDSL
	help
    Tutorial using libcomms
```

## buildroot/package/cpptoml/Config.in
```kconfig
config BR2_PACKAGE_CPPTOML
	bool "cpptoml"
	depends on BR2_INSTALL_LIBSTDCPP
	depends on BR2_USE_WCHAR
	help
	  cpptoml is a header-only library for parsing TOML configuration files.

comment "cpptoml needs a toolchain w/ C++, wchar"
	depends on !BR2_INSTALL_LIBSTDCPP || !BR2_USE_WCHAR
```

## buildroot/package/ecal/Config.in
```kconfig
config BR2_PACKAGE_ECAL
	bool "iceoryx"
	depends on BR2_INSTALL_LIBSTDCPP
	depends on BR2_TOOLCHAIN_HAS_THREADS
	depends on BR2_USE_WCHAR
	select BR2_PACKAGE_TINYXML2
	select BR2_PACKAGE_YAML_CPP
	select BR2_PACKAGE_PROTOBUF
	select BR2_PACKAGE_FLATBUFFERS
	select BR2_PACKAGE_LIBCURL
  select BR2_PACKAGE_ICEORYX
  select BR2_PACKAGE_TCLAP
  select BR2_PACKAGE_CAPNPROTO
  select BR2_PACKAGE_TERMCOLOR
  select BR2_PACKAGE_FTXUI
	help
    eCAL - enhanced Communication Abstraction Layer.
    A high performance publish-subscribe, client-server cross-plattform middleware.

    https://github.com/eclipse-ecal/ecal

comment "iceoryx needs a toolchain w/ C++, threads, wchar"
	depends on !BR2_INSTALL_LIBSTDCPP || !BR2_TOOLCHAIN_HAS_THREADS \
		|| !BR2_USE_WCHAR
```

## buildroot/package/ftxui/Config.in
```kconfig
config BR2_PACKAGE_FTXUI
	bool "ftxui"
	depends on BR2_INSTALL_LIBSTDCPP
	depends on BR2_TOOLCHAIN_HAS_THREADS
	depends on BR2_USE_WCHAR # fmt
	help
    Functional Terminal (X) User interface.
    A simple cross-platform C++ library for terminal based user interfaces!

    https://github.com/ArthurSonzogni/FTXUI

comment "ftxui needs a toolchain w/ C++, threads, wchar"
	depends on !BR2_INSTALL_LIBSTDCPP || !BR2_TOOLCHAIN_HAS_THREADS \
		|| !BR2_USE_WCHAR
```

## buildroot/package/iceoryx/Config.in
```kconfig
config BR2_PACKAGE_ICEORYX
	bool "iceoryx"
	depends on BR2_INSTALL_LIBSTDCPP
	depends on BR2_TOOLCHAIN_HAS_THREADS
	depends on BR2_USE_WCHAR
	select BR2_PACKAGE_CPPTOML
	help
    iceoryx - true zero-copy inter-process-communication

    https://github.com/eclipse-iceoryx/iceoryx

comment "iceoryx needs a toolchain w/ C++, threads, wchar"
	depends on !BR2_INSTALL_LIBSTDCPP || !BR2_TOOLCHAIN_HAS_THREADS \
		|| !BR2_USE_WCHAR
```

## buildroot/package/sniper/Config.in
```kconfig
config BR2_PACKAGE_SNIPER
	bool "sniper"
	help
    Lightweight event-data processing framework in HEP
```

## buildroot/package/tcp_pubsub/Config.in
```kconfig
config BR2_PACKAGE_TCP_PUBSUB
	bool "tcp_pubsub"
	depends on BR2_INSTALL_LIBSTDCPP
	depends on BR2_USE_WCHAR
	help
    tcp_pubsub is a minimal publish-subscribe library that transports data via TCP.

    https://github.com/eclipse-ecal/tcp_pubsub

comment "tcp_pubsub needs a toolchain w/ C++, wchar"
	depends on !BR2_INSTALL_LIBSTDCPP || !BR2_USE_WCHAR
```

## buildroot/package/xdma-tools/Config.in
```kconfig
config BR2_PACKAGE_XDMA_TOOLS
       bool "xdma-tools"
       help
         Tools for Xilinx XDMA driver tests
```

## buildroot/package/xdma/Config.in
```kconfig
config BR2_PACKAGE_XDMA
    bool "xlinix_xdma_pcie_driver"
	help
	  Extra device module for Xlinix xdma PCIe IP
```
