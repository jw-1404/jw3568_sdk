## buildroot/configs/jw3568-v3-recovery_defconfig
```kconfig
#include "base.config"
#include "base_extra.config"
#include "recovery.config"
#include "rk356x_arm64.config"
BR2_ROOTFS_OVERLAY="board/jianwei/common/base board/jianwei/common/recovery board/jianwei/jw3568/fs-overlay-recovery"
BR2_TARGET_GENERIC_GETTY_BAUDRATE_115200=y
```

## buildroot/package/jw-dpu/Config.in
```kconfig
config BR2_PACKAGE_JW_DPU
       bool "jw-dpu"
       help
         Tools for jw3568 on-board unit tests
```

## buildroot/package/python-supervisor-twiddler/Config.in
```kconfig
config BR2_PACKAGE_PYTHON_SUPERVISOR_TWIDDLER
	bool "python-supervisor-twiddler"
	depends on BR2_PACKAGE_SUPERVISOR
	help
    RPC extension for Supervisor that allows Supervisor's configuration
    and state to be manipulated in ways that are not normally possible at runtime.

    https://github.com/mnaberez/supervisor_twiddler
```
